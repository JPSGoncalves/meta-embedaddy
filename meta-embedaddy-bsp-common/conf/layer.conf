## meta-embedaddy-bsp-common/conf/layer.conf
```bitbake
BBPATH .= ":${LAYERDIR}"

BBFILES += "${LAYERDIR}/recipes-*/*/*.bb \
            ${LAYERDIR}/recipes-*/*/*.bbappend"

BBFILE_COLLECTIONS += "embedaddy-bsp-common"
BBFILE_PATTERN_embedaddy-bsp-common := "^${LAYERDIR}/"
BBFILE_PRIORITY_embedaddy-bsp-common = "8"

LAYERDEPENDS_embedaddy-bsp-common = "core"
LAYERSERIES_COMPAT_embedaddy-bsp-common = "scarthgap"
LAYERVERSION_embedaddy-bsp-common = "1"
```

## meta-embedaddy-bsp-sophgo/conf/machine/embdy-milkv-duos.conf
```bitbake
#@TYPE: Machine
#@NAME: milkv-duos
#@SOC: SOPHGO SG2000
#@DESCRIPTION: Machine configuration for Milk-V Duo S

# Settings shared by all Milk-V Duo boards (duo, duo256m, duos)

require conf/machine/include/riscv/tune-riscv.inc

MACHINEOVERRIDES .= ":milkv-duo-common"

PREFERRED_PROVIDER_virtual/kernel ?= "linux-embdy-mainline"
PREFERRED_PROVIDER_virtual/bootloader ?= "u-boot-embdy-mainline"

PREFERRED_VERSION_openocd-native = "riscv"
PREFERRED_VERSION_openocd = "riscv"


# Machine Configuration
SERIAL_CONSOLES = "115200;ttyS0"
MACHINE_FEATURES = "screen keyboard ext2 serial"

# OpenSBI
RISCV_SBI_PLAT = "generic"

# U-Boot Extlinux
UBOOT_EXTLINUX = "1"
UBOOT_EXTLINUX_LABELS = "embdy"
UBOOT_EXTLINUX_MENU_DESCRIPTION:embdy = "Linux MilkV DuoS"
UBOOT_EXTLINUX_KERNEL_IMAGE = "../${KERNEL_IMAGETYPE}"
UBOOT_EXTLINUX_FDT ?= "../${@os.path.basename(d.getVar('KERNEL_DEVICETREE'))}"
UBOOT_EXTLINUX_FDTDIR = ""
UBOOT_EXTLINUX_ROOT = "root=PARTUUID=257bf3ad-3d89-4b5c-844d-3bbeff52d92f"
UBOOT_EXTLINUX_CONSOLE = "console=ttyS0,115200"
UBOOT_EXTLINUX_KERNEL_ARGS = "rootwait rw earlycon=sbi"

# U-Boot Config
UBOOT_MACHINE ?= "milkv_duos_defconfig"

# Kernel Configuration
KERNEL_CLASSES = "kernel"
KERNEL_IMAGETYPE = "Image.gz"
KERNEL_DEVICETREE ?= "sophgo/sg2000-milkv-duo-s.dtb"

# Image Configuration
#WIC_CREATE_EXTRA_ARGS ?= "--no-fstab-update"
IMAGE_FSTYPES += "wic.gz wic.bmap ext4 tar.gz"
EXTRA_IMAGEDEPENDS += "milkv-duo-fsbl"
WKS_FILE ?= "embdy-milkv-duos-sd.wks"
WKS_FILE_DEPENDS:append = " milkv-duo-fsbl virtual/bootloader"
IMAGE_BOOT_FILES ?= " \
                    sg2000-milkv-duo-s.dtb \
                    fip.bin \
                    {KERNEL_IMAGETYPE} \
"
```

## meta-embedaddy-bsp-sophgo/files/wic/embdy-milkv-duos-sd.wks
```
# short-description: MilkV DuoS SD card image

bootloader  --ptable msdos

part /boot --fixed-size=128M  --align 1024 --use-uuid --fstype=vfat --label=boot --source bootimg-partition --active --ondisk=mmcblk0
part /     --size=256M        --align 1024            --fstype=ext4 --label=root --source=rootfs                     --ondisk=mmcblk0
```

## meta-embedaddy-bsp-sophgo/recipes-kernel/linux/files/embdy-milkv-duos/defconfig
```kconfig
CONFIG_SYSVIPC=y
CONFIG_POSIX_MQUEUE=y
CONFIG_NO_HZ_IDLE=y
CONFIG_HIGH_RES_TIMERS=y
CONFIG_BPF_SYSCALL=y
CONFIG_IKCONFIG=y
CONFIG_IKCONFIG_PROC=y
CONFIG_CGROUPS=y
CONFIG_MEMCG=y
CONFIG_BLK_CGROUP=y
CONFIG_CGROUP_SCHED=y
CONFIG_CGROUP_PIDS=y
CONFIG_CGROUP_FREEZER=y
CONFIG_CGROUP_DEVICE=y
CONFIG_CGROUP_CPUACCT=y
CONFIG_CGROUP_BPF=y
CONFIG_ARCH_SOPHGO=y
CONFIG_ERRATA_THEAD=y
# CONFIG_RISCV_ISA_V is not set
CONFIG_JUMP_LABEL=y
CONFIG_MODULES=y
CONFIG_MODULE_UNLOAD=y
CONFIG_NET=y
CONFIG_PACKET=y
CONFIG_UNIX=y
CONFIG_INET=y
CONFIG_IP_MULTICAST=y
CONFIG_DEVTMPFS=y
CONFIG_DEVTMPFS_MOUNT=y
CONFIG_BLK_DEV_LOOP=y
CONFIG_SCSI=y
CONFIG_BLK_DEV_SD=y
CONFIG_NETDEVICES=y
CONFIG_STMMAC_ETH=y
# CONFIG_DWMAC_SOPHGO is not set
CONFIG_MDIO_BUS_MUX_MMIOREG=y
# CONFIG_INPUT_KEYBOARD is not set
# CONFIG_INPUT_MOUSE is not set
CONFIG_SERIAL_8250=y
CONFIG_SERIAL_8250_CONSOLE=y
CONFIG_SERIAL_8250_NR_UARTS=5
CONFIG_SERIAL_8250_RUNTIME_UARTS=5
CONFIG_SERIAL_8250_DW=y
CONFIG_SERIAL_EARLYCON_RISCV_SBI=y
CONFIG_I2C=y
CONFIG_I2C_CHARDEV=y
CONFIG_I2C_DESIGNWARE_CORE=y
# CONFIG_PTP_1588_CLOCK is not set
CONFIG_PINCTRL=y
CONFIG_PINCTRL_SOPHGO_SG2000=y
CONFIG_GPIOLIB=y
CONFIG_GPIO_DWAPB=y
CONFIG_MFD_SYSCON=y
CONFIG_USB=y
CONFIG_USB_DWC2=y
CONFIG_USB_DWC2_HOST=y
CONFIG_USB_STORAGE=y
CONFIG_MMC=y
CONFIG_MMC_SDHCI=y
CONFIG_MMC_SDHCI_PLTFM=y
CONFIG_MMC_SDHCI_OF_DWCMSHC=y
CONFIG_RTC_CLASS=y
CONFIG_RTC_DRV_CV1800=y
CONFIG_DMADEVICES=y
CONFIG_DW_AXI_DMAC=y
CONFIG_SOPHGO_CV1800B_DMAMUX=y
CONFIG_CLK_SOPHGO_CV1800=y
CONFIG_SOPHGO_CV1800_RTCSYS=y
CONFIG_IIO=y
CONFIG_SOPHGO_CV1800B_ADC=m
CONFIG_PHY_SOPHGO_CV1800_USB2=y
CONFIG_EXT4_FS=y
CONFIG_EXT4_FS_POSIX_ACL=y
CONFIG_EXT4_FS_SECURITY=y
CONFIG_AUTOFS_FS=y
CONFIG_OVERLAY_FS=m
CONFIG_VFAT_FS=y
CONFIG_TMPFS=y
CONFIG_TMPFS_POSIX_ACL=y
CONFIG_NLS_CODEPAGE_437=y
CONFIG_NLS_ISO8859_1=y
CONFIG_CRYPTO=y
CONFIG_CRYPTO_USER_API_HASH=y
CONFIG_PRINTK_TIME=y
CONFIG_MAGIC_SYSRQ=y
CONFIG_DEBUG_FS=y
# CONFIG_RUNTIME_TESTING_MENU is not set
```

## meta-embedaddy-distro/conf/distro/embdy-sd.conf
```bitbake
DISTRO = "embdy-sd"
DISTROOVERRIDES .= ":embdy-distro"
DISTRO_NAME = "Embedaddy Development Distro (systemd)"
DISTRO_VERSION = "1.0"
MAINTAINER = "jpaulo.silvagoncalves@gmail.com"
SDK_VENDOR = "-embdysdsdk"

EMBEDADDY_DISTRO_FEATURES = "acl xattr ipv4 ipv6 vfat seccomp pni-names usrmerge"
DISTRO_FEATURES = "${EMBEDADDY_DISTRO_FEATURES}"

INIT_MANAGER = "systemd"
VIRTUAL-RUNTIME_base-utils = "busybox"
VIRTUAL-RUNTIME_base-utils-syslog = ""
VIRTUAL-RUNTIME_base-utils-hwclock = ""

PACKAGE_CLASSES = "package_ipk"

IMAGE_LINGUAS ?= "en-us"

INHERIT += "buildhistory"
BUILDHISTORY_COMMIT = "1"
BUILDHISTORY_FEATURES ?= "image"
```

## meta-embedaddy-distro/conf/layer.conf
```bitbake
# LAYERDIR on BBPATH puts wic/ on WKS_SEARCH_PATH.
BBPATH .= ":${LAYERDIR}"

BBFILES += "${LAYERDIR}/recipes-*/*/*.bb \
            ${LAYERDIR}/recipes-*/*/*.bbappend"

BBFILE_COLLECTIONS += "embedaddy-distro"
BBFILE_PATTERN_embedaddy-distro := "^${LAYERDIR}/"

# Above meta-st-stm32mp-addons (7).
BBFILE_PRIORITY_embedaddy-distro = "8"

LAYERDEPENDS_embedaddy-distro = "core"
LAYERSERIES_COMPAT_embedaddy-distro = "scarthgap"
LAYERVERSION_embedaddy-distro = "1"
```
